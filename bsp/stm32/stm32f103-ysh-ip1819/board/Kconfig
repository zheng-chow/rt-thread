## bsp/stm32/stm32f103-ysh-ip1819/board/Kconfig
```kconfig
menu "Hardware Drivers Config"

config SOC_STM32F103C8
    bool
    select SOC_SERIES_STM32F1
    select RT_USING_COMPONENTS_INIT
    select RT_USING_USER_MAIN
    default y

menu "On-chip Peripheral Drivers"

    config BSP_USING_GPIO
        bool "Enable GPIO"
        select RT_USING_PIN
        default y

    menuconfig BSP_USING_UART
        bool "Enable UART"
        default y
        select RT_USING_SERIAL
        if BSP_USING_UART
            config BSP_USING_UART1
                bool "Enable UART1"
                default y

            config BSP_UART1_RX_USING_DMA
                bool "Enable UART1 RX DMA"
                depends on BSP_USING_UART1 && RT_SERIAL_USING_DMA
                default n
        endif

    menuconfig BSP_USING_SPI
        bool "Enable SPI BUS"
        default n
        select RT_USING_SPI
        if BSP_USING_SPI
            config BSP_USING_SPI1
                bool "Enable SPI1 BUS"
                default n

            config BSP_SPI1_TX_USING_DMA
                bool "Enable SPI1 TX DMA"
                depends on BSP_USING_SPI1
                default n
                        
            config BSP_SPI1_RX_USING_DMA
                bool "Enable SPI1 RX DMA"
                depends on BSP_USING_SPI1
                select BSP_SPI1_TX_USING_DMA
                default n
        endif
    
endmenu

menu "Board extended module Drivers"

endmenu

endmenu
```

## bsp/stm32/stm32f103-zingto-RWS-FOC/board/Kconfig
```kconfig
menu "Hardware Drivers Config"

config SOC_STM32F103RE
    bool
    select SOC_SERIES_STM32F1
    select RT_USING_COMPONENTS_INIT
    select RT_USING_USER_MAIN
    default y

menu "On-chip Peripheral Drivers"

    config BSP_USING_GPIO
        bool "Enable GPIO"
        select RT_USING_PIN
        default y

    menuconfig BSP_USING_UART
        bool "Enable UART"
        default y
        select RT_USING_SERIAL
        if BSP_USING_UART
            config BSP_USING_UART1
                bool "Enable UART1"
                default y

            config BSP_UART1_RX_USING_DMA
                bool "Enable UART1 RX DMA"
                depends on BSP_USING_UART1 && RT_SERIAL_USING_DMA
                default n
            
             config BSP_USING_UART3
                bool "Enable UART3"
                default y
				
			config BSP_UART3_RX_USING_DMA
                bool "Enable UART3 RX DMA"
                depends on BSP_USING_UART3 && RT_SERIAL_USING_DMA
                default y
				
           	config BSP_UART3_TX_USING_DMA
                bool "Enable UART3 TX DMA"
                depends on BSP_USING_UART3 && RT_SERIAL_USING_DMA
                default y
		   
		   
        endif

    menuconfig BSP_USING_I2C1
        bool "Enable I2C1 BUS (software simulation)"
        default n
        select RT_USING_I2C
        select RT_USING_I2C_BITOPS
        select RT_USING_PIN
        if BSP_USING_I2C1
            config BSP_I2C1_SCL_PIN
                int "i2c1 scl pin number"
                range 1 216
                default 15
            config BSP_I2C1_SDA_PIN
                int "I2C1 sda pin number"
                range 1 216
                default 16
        endif

    
    menuconfig BSP_USING_CAN
        bool "Enable CAN"
        default n
        select RT_USING_CAN
        if BSP_USING_CAN
            config BSP_USING_CAN1
                bool "using CAN1"
                default n
        endif

    menuconfig BSP_USING_PWM
        bool "Enable pwm"
        default n
        if BSP_USING_PWM
            menuconfig BSP_USING_FOC
                bool "Complementary output"
                default n  
                select RT_USING_HWTIMER
                select RT_USING_ADC				
                if !BSP_USING_FOC
                    if BSP_USING_PWM
                        menuconfig BSP_USING_PWM1
                            bool "Enable timer1 output pwm"
                            default n
                            select RT_USING_PWM
                            if BSP_USING_PWM1
                                config BSP_USING_PWM1_CH1
                                    bool "Enable PWM1 channel1"
                                    default n

                                config BSP_USING_PWM1_CH2
                                    bool "Enable PWM1 channel2"
                                    default n

                                config BSP_USING_PWM1_CH3
                                    bool "Enable PWM1 channel3"
                                    default n
                            endif

                    endif   
                endif                   
        endif

    menuconfig BSP_USING_TIM
        bool "Enable TIM"
        default n
        select RT_USING_HWTIMER
        if BSP_USING_TIM
            config BSP_USING_TIM5
                bool "using TIM5"
                default n   
            config BSP_USING_TIM6
                bool "using TIM6"
                default n  	
            config BSP_USING_TIM7
                bool "using TIM7"
                default n  	
            config BSP_USING_TIM8
                bool "using TIM8"
                default n  	
        endif

endmenu

menu "Board extended module Drivers"


endmenu

endmenu
```

## bsp/stm32/stm32f103-zingto-RWS-IMU/board/Kconfig
```kconfig
menu "Hardware Drivers Config"

config SOC_STM32F103RE
    bool
    select SOC_SERIES_STM32F1
    select RT_USING_COMPONENTS_INIT
    select RT_USING_USER_MAIN
    default y

menu "On-chip Peripheral Drivers"

    config BSP_USING_GPIO
        bool "Enable GPIO"
        select RT_USING_PIN
        default y

    menuconfig BSP_USING_PWM
        bool "Enable pwm"
        default n
        select RT_USING_PWM
        if BSP_USING_PWM
        menuconfig BSP_USING_PWM3
            bool "Enable timer3 output pwm"
            default n
            if BSP_USING_PWM3
                config BSP_USING_PWM3_CH3
                    bool "Enable PWM3 channel3"
                    default y
            endif
        endif

    menuconfig BSP_USING_UART
        bool "Enable UART"
        default y
        select RT_USING_SERIAL
        if BSP_USING_UART
            config BSP_USING_UART1
                bool "Enable UART1"
                default y

            config BSP_UART1_RX_USING_DMA
                bool "Enable UART1 RX DMA"
                depends on BSP_USING_UART1 && RT_SERIAL_USING_DMA
                default n
        endif
        
    menuconfig BSP_USING_SPI
        bool "Enable SPI BUS"
        default n
        select RT_USING_SPI
        if BSP_USING_SPI
            config BSP_USING_SPI1
                bool "Enable SPI1 BUS"
                default n

            if BSP_USING_SPI1
                config BSP_SPI1_TX_USING_DMA
                    bool "Enable SPI1 TX DMA"
                    depends on BSP_USING_SPI1
                    default n
                    
                config BSP_SPI1_RX_USING_DMA
                    bool "Enable SPI1 RX DMA"
                    depends on BSP_USING_SPI1
                    select BSP_SPI1_TX_USING_DMA
                    default n
            endif
            
            config BSP_USING_SPI2
                bool "Enable SPI2 BUS"
                default n

            if BSP_USING_SPI2
                config BSP_SPI2_TX_USING_DMA
                    bool "Enable SPI2 TX DMA"
                    depends on BSP_USING_SPI2
                    default n
                    
                config BSP_SPI2_RX_USING_DMA
                    bool "Enable SPI2 RX DMA"
                    depends on BSP_USING_SPI2
                    select BSP_SPI2_TX_USING_DMA
                    default n
            endif

        endif
    
    menuconfig BSP_USING_CAN
        bool "Enable CAN"
        default n
        select RT_USING_CAN
        if BSP_USING_CAN
            config BSP_USING_CAN1
                bool "using CAN1"
                default n
        endif
    
endmenu

menu "Board extended module Drivers"

    menuconfig BSP_USING_ADIS16334
        bool "Enable ADIS16334 IMU Sensor"
        default n
        select BSP_USING_SPI
        if BSP_USING_ADIS16334
            config BSP_USING_ADIS16334_ACCE
            bool "using accelerator in ADIS16334"
            default n

            config BSP_USING_ADIS16334_GYRO
            bool "using gyroscope in ADIS16334"
            default n
        endif

    menuconfig BSP_USING_RM3100
        bool "Enable RM3100 GeoMag Sensor"
        default n
        select BSP_USING_SPI
        if BSP_USING_RM3100
            config BSP_RM3100_DATA_RATE
            int "data rate(HZ)"
            default 100
        endif        

endmenu

endmenu
```

## bsp/stm32/stm32f103-zingto-RWS-SERVO/board/Kconfig
```kconfig
menu "Hardware Drivers Config"

config SOC_STM32F103RE
    bool
    select SOC_SERIES_STM32F1
    select RT_USING_COMPONENTS_INIT
    select RT_USING_USER_MAIN
    default y

menu "On-chip Peripheral Drivers"

    config BSP_USING_GPIO
        bool "Enable GPIO"
        select RT_USING_PIN
        default y

    menuconfig BSP_USING_PWM
        bool "Enable PWM out"
        default n
        select RT_USING_PWM
        if BSP_USING_PWM
        menuconfig BSP_USING_PWM2
            bool "Enable timer2 output pwm"
            default n
            if BSP_USING_PWM2
                config BSP_USING_PWM2_CH1
                    bool "Enable PWM2 channel1"
                    default y
            endif
            
        menuconfig BSP_USING_PWM3
            bool "Enable timer3 output pwm"
            default n
            if BSP_USING_PWM3
                config BSP_USING_PWM3_CH3
                    bool "Enable PWM3 channel3"
                    default y
            endif
        endif

    menuconfig BSP_USING_UART
        bool "Enable UART"
        default y
        select RT_USING_SERIAL
        if BSP_USING_UART
            config BSP_USING_UART1
                bool "Enable UART1"
                default y

            config BSP_UART1_RX_USING_DMA
                bool "Enable UART1 RX DMA"
                depends on BSP_USING_UART1 && RT_SERIAL_USING_DMA
                default n
        endif
        
    menuconfig BSP_USING_SPI
        bool "Enable SPI BUS"
        default n
        select RT_USING_SPI
        if BSP_USING_SPI
            config BSP_USING_SPI1
                bool "Enable SPI1 BUS"
                default n

            config BSP_SPI1_TX_USING_DMA
                bool "Enable SPI1 TX DMA"
                depends on BSP_USING_SPI1
                default n
                
            config BSP_SPI1_RX_USING_DMA
                bool "Enable SPI1 RX DMA"
                depends on BSP_USING_SPI1
                select BSP_SPI1_TX_USING_DMA
                default n

        endif

    
    menuconfig BSP_USING_CAN
        bool "Enable CAN"
        default n
        select RT_USING_CAN
        if BSP_USING_CAN
            config BSP_USING_CAN1
                bool "using CAN1"
                default n
        endif
    
endmenu

menu "Board extended module Drivers"

    menuconfig BSP_USING_ADIS16334
        bool "Enable ADIS16334 IMU"
        default n
        select BSP_USING_SPI
        if BSP_USING_ADIS16334
            config BSP_USING_ADIS16334_ACCE
            bool "using accelerator in ADIS16334"
            default n

            config BSP_USING_ADIS16334_GYRO
            bool "using gyroscope in ADIS16334"
            default n
        endif
        

endmenu

endmenu
```

## bsp/stm32/stm32f103-zingto-guardian-2K06/board/Kconfig
```kconfig
menu "BSP Customize Config"

config SOC_STM32F103xE
    bool
    select SOC_SERIES_STM32F1
    select RT_USING_COMPONENTS_INIT
    select RT_USING_USER_MAIN
    default y

menu "Product Customize Options"
    choice 
        prompt "SBUS Customize"
        default CUSTOM_SBUS_DEFAULT

        config CUSTOM_SBUS_DEFAULT
            bool "Default Version"

        config CUSTOM_SBUS_PUZHI
            bool "2020 Version, PuZhi"

        config CUSTOM_SBUS_PUZHI0911
            bool "2020 Version, 0911 PuZhi"

        config CUSTOM_SBUS_LIANGZW
            bool "2020 Version, Liang Zhi Wei"

        config CUSTOM_SBUS_VOLERS
            bool "2020 Version, Volers Encoding Board"

    endchoice

    choice 
        prompt "UART Customize"
        default CUSTOM_UART_DEFAULT

        config CUSTOM_UART_DEFAULT
            bool "Default Version"

        config CUSTOM_UART_PUZHI
            bool "2020 Version, PuZhi"

        config CUSTOM_UART_PUZHI0911
            bool "2020 Version, 0911 PuZhi"

        config CUSTOM_UART_LIANGZW
            bool "2020 Version, Liang Zhi Wei"

        config CUSTOM_UART_VOLERS
            bool "2020 Version, Volers Encoding Board"

    endchoice

    choice 
        prompt "CAM. Customize"
        default CAMERA_MODEL_3521

        config CAMERA_MODEL_3521
            bool "Default Version, ZINGTO Hi3521D"

        config CAMERA_MODEL_HU
            bool "2020 Version, Low Cost, HU"

        config CAMERA_MODEL_VOLERS
            bool "2020 Version, Volers Encoding Board"

    endchoice

endmenu

menu "On-chip Peripheral Drivers"

    config BSP_USING_GPIO
        bool "Enable GPIO"
        select RT_USING_PIN
        default y

    menuconfig BSP_USING_UART
        bool "Enable UART"
        default y
        select RT_USING_SERIAL
        if BSP_USING_UART
            config BSP_USING_UART1
                bool "Enable UART1"
                default y

            config BSP_UART1_RX_USING_DMA
                bool "Enable UART1 RX DMA"
                depends on BSP_USING_UART1 && RT_SERIAL_USING_DMA
                default n

            config BSP_UART1_TX_USING_DMA
                bool "Enable UART1 TX DMA"
                depends on BSP_USING_UART1 && RT_SERIAL_USING_DMA
                default n

            config BSP_USING_UART2
                bool "Enable UART2"
                default y

            config BSP_UART2_RX_USING_DMA
                bool "Enable UART2 RX DMA"
                depends on BSP_USING_UART2 && RT_SERIAL_USING_DMA
                default n

            config BSP_UART2_TX_USING_DMA
                bool "Enable UART2 TX DMA"
                depends on BSP_USING_UART2 && RT_SERIAL_USING_DMA
                default n

            config BSP_USING_UART3
                bool "Enable UART3"
                default y

            config BSP_UART3_RX_USING_DMA
                bool "Enable UART3 RX DMA"
                depends on BSP_USING_UART3 && RT_SERIAL_USING_DMA
                default n

            config BSP_UART3_TX_USING_DMA
                bool "Enable UART3 TX DMA"
                depends on BSP_USING_UART3 && RT_SERIAL_USING_DMA
                default n

            config BSP_USING_UART4
                bool "Enable UART4"
                default y

            config BSP_UART4_RX_USING_DMA
                bool "Enable UART4 RX DMA"
                depends on BSP_USING_UART4 && RT_SERIAL_USING_DMA
                default n

            config BSP_UART4_TX_USING_DMA
                bool "Enable UART4 TX DMA"
                depends on BSP_USING_UART4 && RT_SERIAL_USING_DMA
                default n
            
            config BSP_USING_UART5
                bool "Enable UART5"
                default y

        endif

    config BSP_USING_WDT
        bool "Enable Watchdog Timer"
        select RT_USING_WDT
        default y

    source "../libraries/HAL_Drivers/Kconfig"
       
endmenu

endmenu
```
